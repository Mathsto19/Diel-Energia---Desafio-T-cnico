## firmware/main/Kconfig.projbuild
```kconfig
menu "Configuracao do exemplo"

    config EXAMPLE_SENSORS_MODBUS_TCP
        bool "Usar sensores Modbus TCP"
        default n
        help
            Consulta temperatura e umidade em registradores Modbus TCP.
            Desative para usar a leitura simulada do firmware.

    choice EXAMPLE_CERT_VALIDATION
        prompt "Metodo de validacao do certificado"
        default EXAMPLE_CERT_VALIDATE_BUNDLE
        help
            Escolha como validar o certificado TLS do servidor.
            - Conjunto de certificados (default).
            - Certificado incorporado

        config EXAMPLE_CERT_VALIDATE_BUNDLE
            bool "Conjunto de certificados"

        config EXAMPLE_CERT_VALIDATE_MOSQUITTO_CA
            bool "Certificado incorporado"

    endchoice

    config EXAMPLE_MQTT_BROKER_URI
        string "URI do servidor MQTT"
        default "mqtts://test.mosquitto.org:8886"
        default "mqtts://test.mosquitto.org:8883" if EXAMPLE_CERT_VALIDATE_MOSQUITTO_CA
        help
            URI do servidor MQTT.
            Ao usar o servidor do exemplo, a porta deve ser 8883 ao testar
            o certificado incorporado

    config EXAMPLE_BROKER_CERTIFICATE_OVERRIDE
        string "Substituto do certificado do servidor (corpo PEM)"
        default ""
        help
            Opcional: substitua o certificado do servidor incorporando um PEM criado
            a partir deste corpo em base64. Deixe vazio para usar o conjunto de certificados ou o
            certificado Mosquitto incorporado. Informe somente o conteudo base64, sem os
            marcadores BEGIN/END.

    config EXAMPLE_BROKER_CERTIFICATE_OVERRIDDEN
        bool
        default y if EXAMPLE_BROKER_CERTIFICATE_OVERRIDE != ""

endmenu
```
